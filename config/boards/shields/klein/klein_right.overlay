/*
 * Copyright (c) 2020 Derek Schmell
 *
 * SPDX-License-Identifier: MIT
 */

#include "klein.dtsi"

&default_transform {
	col-offset = <5>;
};
&kscan0 {
    col-gpios
        = <&pro_micro_d 1  (GPIO_ACTIVE_HIGH | GPIO_PULL_DOWN)>
        , <&pro_micro_d 0  (GPIO_ACTIVE_HIGH | GPIO_PULL_DOWN)>
        , <&pro_micro_d 15  (GPIO_ACTIVE_HIGH | GPIO_PULL_DOWN)>
        , <&pro_micro_d 14  (GPIO_ACTIVE_HIGH | GPIO_PULL_DOWN)>
        , <&pro_micro_d 16  (GPIO_ACTIVE_HIGH | GPIO_PULL_DOWN)>
        ;
};

&right_encoder {
    status = "okay";
};
